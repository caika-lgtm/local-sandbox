## kernel/shuru_x86_64_defconfig
```kconfig
# Shuru microVM kernel config for x86_64
# Minimal x86_64 kernel for Apple Virtualization.framework
# Based on ARM Shuru capability set + minimal x86 boot support
# All drivers built-in (no loadable modules)

# Architecture / boot
CONFIG_SMP=y
CONFIG_NR_CPUS=16
CONFIG_HYPERVISOR_GUEST=y
CONFIG_PARAVIRT=y

# No loadable modules
# CONFIG_MODULES is not set

# General
CONFIG_SYSVIPC=y
CONFIG_POSIX_MQUEUE=y
CONFIG_NO_HZ_IDLE=y
CONFIG_HIGH_RES_TIMERS=y
CONFIG_PREEMPT_VOLUNTARY=y
CONFIG_HZ_100=y
CONFIG_SYSCTL=y
CONFIG_MULTIUSER=y
CONFIG_FHANDLE=y
CONFIG_EPOLL=y
CONFIG_SIGNALFD=y
CONFIG_TIMERFD=y
CONFIG_EVENTFD=y
CONFIG_AIO=y
CONFIG_IO_URING=y

# Size optimization
CONFIG_CC_OPTIMIZE_FOR_SIZE=y
# CONFIG_DEBUG_KERNEL is not set
# CONFIG_DEBUG_INFO is not set
# CONFIG_FTRACE is not set
# CONFIG_KPROBES is not set
# CONFIG_PROFILING is not set

# PCI / VirtIO transport
CONFIG_PCI=y
CONFIG_VIRTIO=y
CONFIG_VIRTIO_PCI=y
CONFIG_VIRTIO_MENU=y

# VirtIO devices (all built-in)
CONFIG_VIRTIO_BLK=y
CONFIG_VIRTIO_CONSOLE=y
CONFIG_VIRTIO_NET=y
CONFIG_VIRTIO_BALLOON=y
CONFIG_HW_RANDOM=y
CONFIG_HW_RANDOM_VIRTIO=y
CONFIG_VIRTIO_FS=y
CONFIG_VIRTIO_INPUT=y

# vsock (all built-in)
CONFIG_VSOCKETS=y
CONFIG_VIRTIO_VSOCKETS=y
CONFIG_VIRTIO_VSOCKETS_COMMON=y

# Block layer
CONFIG_BLOCK=y
CONFIG_BLK_DEV=y
CONFIG_BLK_DEV_INITRD=y

# Filesystems
CONFIG_EXT4_FS=y
CONFIG_EXT4_FS_POSIX_ACL=y
CONFIG_EXT4_USE_FOR_EXT2=y
CONFIG_OVERLAY_FS=y
CONFIG_FUSE_FS=y
CONFIG_TMPFS=y
CONFIG_TMPFS_POSIX_ACL=y
CONFIG_PROC_FS=y
CONFIG_PROC_SYSCTL=y
CONFIG_SYSFS=y
CONFIG_DEVTMPFS=y
CONFIG_DEVTMPFS_MOUNT=y
CONFIG_DEVPTS_FS=y
CONFIG_CONFIGFS_FS=y

# Networking
CONFIG_NET=y
CONFIG_NETDEVICES=y
CONFIG_LOOPBACK=y
CONFIG_PACKET=y
CONFIG_UNIX=y
CONFIG_INET=y
CONFIG_IP_MULTICAST=y
CONFIG_IP_ADVANCED_ROUTER=y
CONFIG_IP_MULTIPLE_TABLES=y
CONFIG_IP_ROUTE_MULTIPATH=y
CONFIG_IPV6=y
CONFIG_BRIDGE=y

# Netfilter (for iptables REDIRECT in proxy mode)
CONFIG_NETFILTER=y
CONFIG_NETFILTER_ADVANCED=y
CONFIG_NETFILTER_XTABLES=y
CONFIG_NETFILTER_XT_MATCH_CONNTRACK=y
CONFIG_NETFILTER_XT_MATCH_STATE=y
CONFIG_NETFILTER_XT_TARGET_REDIRECT=y
CONFIG_NF_CONNTRACK=y
CONFIG_NF_NAT=y
CONFIG_NF_TABLES=y
CONFIG_NF_TABLES_INET=y
CONFIG_NFT_NAT=y
CONFIG_NFT_REDIR=y
CONFIG_NFT_CT=y
CONFIG_IP_NF_IPTABLES=y
CONFIG_IP_NF_FILTER=y
CONFIG_IP_NF_NAT=y
CONFIG_IP_NF_TARGET_REDIRECT=y
CONFIG_IP_NF_TARGET_MASQUERADE=y

# CRC32 (required by ext4)
CONFIG_CRC32=y
CONFIG_LIBCRC32C=y
CONFIG_CRYPTO_CRC32C=y

# TTY / Console
CONFIG_TTY=y
CONFIG_VT=y
CONFIG_SERIAL_EARLYCON=y
CONFIG_HVC_DRIVER=y
CONFIG_PRINTK=y

# PTY support (for shell/TTY exec)
CONFIG_UNIX98_PTYS=y

# Cgroups (future container features)
CONFIG_CGROUPS=y
CONFIG_CGROUP_CPUACCT=y
CONFIG_CGROUP_DEVICE=y
CONFIG_CGROUP_FREEZER=y
CONFIG_CGROUP_PIDS=y
CONFIG_CGROUP_SCHED=y
CONFIG_MEMCG=y

# Namespaces
CONFIG_NAMESPACES=y
CONFIG_UTS_NS=y
CONFIG_IPC_NS=y
CONFIG_PID_NS=y
CONFIG_NET_NS=y
CONFIG_USER_NS=y

# inotify (used by many tools)
CONFIG_INOTIFY_USER=y

# RTC (x86 uses CMOS rather than ARM's PL031)
CONFIG_RTC_CLASS=y
CONFIG_RTC_HCTOSYS=y
CONFIG_RTC_HCTOSYS_DEVICE="rtc0"
CONFIG_RTC_INTF_SYSFS=y
CONFIG_RTC_INTF_DEV=y
CONFIG_RTC_DRV_CMOS=y

# Disable unnecessary subsystems
# CONFIG_WERROR is not set
# CONFIG_AUDIT is not set
# CONFIG_SWAP is not set
# CONFIG_NUMA is not set
# CONFIG_X86_CPUID is not set
# CONFIG_X86_MSR is not set
# CONFIG_X86_CHECK_BIOS_CORRUPTION is not set
# CONFIG_EFI is not set
# CONFIG_EFI_STUB is not set
# CONFIG_EFI_MIXED is not set
# CONFIG_PM_DEBUG is not set
# CONFIG_PM_TRACE_RTC is not set
# CONFIG_ACPI_VIDEO is not set
# CONFIG_ACPI_DOCK is not set
# CONFIG_ACPI_BGRT is not set
# CONFIG_CPU_FREQ is not set
# CONFIG_IA32_EMULATION is not set
# CONFIG_BINFMT_MISC is not set
# CONFIG_IP_PNP is not set
# CONFIG_IP_MROUTE is not set
# CONFIG_SYN_COOKIES is not set
# CONFIG_TCP_CONG_ADVANCED is not set
# CONFIG_TCP_MD5SIG is not set
# CONFIG_XFRM_USER is not set
# CONFIG_NET_9P is not set
# CONFIG_NET_9P_VIRTIO is not set
# CONFIG_PCIEPORTBUS is not set
# CONFIG_HOTPLUG_PCI is not set
# CONFIG_PCCARD is not set
# CONFIG_PCMCIA is not set
# CONFIG_YENTA is not set
# CONFIG_CONNECTOR is not set
# CONFIG_MACINTOSH_DRIVERS is not set
# CONFIG_NETCONSOLE is not set
# CONFIG_TIGON3 is not set
# CONFIG_NET_TULIP is not set
# CONFIG_E100 is not set
# CONFIG_E1000 is not set
# CONFIG_E1000E is not set
# CONFIG_SKY2 is not set
# CONFIG_FORCEDETH is not set
# CONFIG_8139TOO is not set
# CONFIG_R8169 is not set
# CONFIG_WLAN is not set
# CONFIG_WIRELESS is not set
# CONFIG_RFKILL is not set
# CONFIG_INPUT_EVDEV is not set
# CONFIG_INPUT_KEYBOARD is not set
# CONFIG_INPUT_MOUSE is not set
# CONFIG_INPUT_TOUCHSCREEN is not set
# CONFIG_INPUT_JOYSTICK is not set
# CONFIG_INPUT_TABLET is not set
# CONFIG_INPUT_MISC is not set
# CONFIG_SERIO is not set
# CONFIG_SERIAL_8250 is not set
# CONFIG_SERIAL_NONSTANDARD is not set
# CONFIG_NVRAM is not set
# CONFIG_HPET is not set
# CONFIG_I2C is not set
# CONFIG_AGP is not set
# CONFIG_HWMON is not set
# CONFIG_THERMAL is not set
# CONFIG_BACKLIGHT_CLASS_DEVICE is not set
# CONFIG_HID is not set
# CONFIG_USB_SUPPORT is not set
# CONFIG_LEDS_CLASS is not set
# CONFIG_DMADEVICES is not set
# CONFIG_SYNC_FILE is not set
# CONFIG_ACPI_WMI is not set
# CONFIG_EEEPC_LAPTOP is not set
# CONFIG_AMD_IOMMU is not set
# CONFIG_INTEL_IOMMU is not set
# CONFIG_EXT4_FS_SECURITY is not set
# CONFIG_QUOTA is not set
# CONFIG_AUTOFS_FS is not set
# CONFIG_NFS_FS is not set
# CONFIG_CIFS is not set
# CONFIG_BTRFS_FS is not set
# CONFIG_XFS_FS is not set
# CONFIG_ISO9660_FS is not set
# CONFIG_MSDOS_FS is not set
# CONFIG_VFAT_FS is not set
# CONFIG_HUGETLBFS is not set
# CONFIG_9P_FS is not set
# CONFIG_NLS is not set
# CONFIG_KEYS is not set
# CONFIG_SECURITY is not set
# CONFIG_SECURITYFS is not set
# CONFIG_PAGE_TABLE_CHECK is not set
# CONFIG_DEBUG_FS is not set
# CONFIG_MAGIC_SYSRQ is not set
# CONFIG_SCHEDSTATS is not set
# CONFIG_SOUND is not set
# CONFIG_SCSI is not set
# CONFIG_ATA is not set
# CONFIG_DRM is not set
# CONFIG_FB is not set
# CONFIG_VGA_CONSOLE is not set
# CONFIG_MEDIA_SUPPORT is not set
# CONFIG_POWER_SUPPLY is not set
# CONFIG_MD is not set
```
